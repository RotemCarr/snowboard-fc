/*
 * Snowboard flight controller, Cortex-M33 cores.
 *
 * SPDX-License-Identifier: Apache-2.0
 */

/dts-v1/;

#include <raspberrypi/rpi_pico/rp2350a.dtsi>
#include <raspberrypi/rpi_pico/m33.dtsi>

#include "snowboard.dtsi"

#include <../boards/common/usb/cdc_acm_serial.dtsi>
