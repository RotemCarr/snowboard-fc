## CMakeLists.txt
```
cmake_minimum_required(VERSION 3.20.0)
find_package(Zephyr REQUIRED HINTS $ENV{ZEPHYR_BASE})
project(snowboard_fc)
target_sources(app PRIVATE src/flight_loop.c)
```

## prj.conf
```kconfig
CONFIG_COMPILER_WARNINGS_AS_ERRORS=y
CONFIG_FC_LIB=y
```

## boards/snowboard_rp2350a_m33_0.overlay
```dts
/ {
	aliases {
		imu0 = &imu;
	};
};
```

## src/flight_loop.c
```c
#include <zephyr/kernel.h>
#include <zephyr/logging/log.h>

#include "fc/arming.h"

LOG_MODULE_REGISTER(flight_loop);

static fc_arming_config_t arming_cfg;
static fc_arming_ctx_t arming_ctx;

int main(void) {
  printk("Hello from: %s\r\n", CONFIG_BOARD_TARGET);

  fc_arming_config_default(&arming_cfg);
  fc_arming_init(&arming_ctx);

  return 0;
}
```
