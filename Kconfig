## boards/snowboard/Kconfig.defconfig
```kconfig
# SPDX-License-Identifier: Apache-2.0

if BOARD_SNOWBOARD

source "boards/common/usb/Kconfig.cdc_acm_serial.defconfig"

config USB_SELF_POWERED
	default n

endif # BOARD_SNOWBOARD
```

## boards/snowboard/Kconfig.snowboard
```kconfig
# SPDX-License-Identifier: Apache-2.0

config BOARD_SNOWBOARD
	select SOC_RP2350A_M33_0 if BOARD_SNOWBOARD_RP2350A_M33_0
```

## boards/snowboard/board.yml
```yaml
board:
  name: snowboard
  full_name: Snowboard RP2350A flight controller
  socs:
    - name: rp2350a
```

## lib/fc/Kconfig
```kconfig
config FC_LIB
	bool "Snowboard flight logic library"
	help
	  Arming state machine, filters, PID and mixer (lib/fc).
	  Pure C with no Zephyr dependencies.
```

## tests/lib/fc/crsf/testcase.yaml
```yaml
tests:
  lib.fc.crsf:
    tags:
      - fc
      - crsf
    platform_allow:
      - native_sim/native/64
    integration_platforms:
      - native_sim/native/64
```

## west.yml
```yaml
manifest:
  remotes:
    - name: zephyrproject
      url-base: https://github.com/zephyrproject-rtos
  projects:
    - name: zephyr
      remote: zephyrproject
      revision: v4.4.2
      import:
        name-allowlist:
          - hal_rpi_pico
          - cmsis_6
  self:
    path: snowboard-fc
```
